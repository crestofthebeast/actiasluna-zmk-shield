## Kconfig.defconfig
```kconfig
# Copyright (c) 2020 The ZMK Contributors
# SPDX-License-Identifier: MIT

if SHIELD_ACTIASLUNA

config ZMK_KEYBOARD_NAME
    default "Actias Luna"

config ZMK_DISPLAY
	select LVGL_USE_CONT
	select LVGL_FONT_MONTSERRAT_26

config SPI
	default y

if ZMK_DISPLAY

config LS0XX
	default y

config SYSTEM_WORKQUEUE_STACK_SIZE
    default 2048

choice ZMK_DISPLAY_STATUS_SCREEN
        default ZMK_DISPLAY_STATUS_SCREEN_CUSTOM
endchoice

choice LVGL_THEME_DEFAULT_FONT_NORMAL
    default LVGL_THEME_DEFAULT_FONT_NORMAL_MONTSERRAT_26

endchoice

choice LVGL_THEME_DEFAULT_FONT_SMALL
    default LVGL_THEME_DEFAULT_FONT_SMALL_MONTSERRAT_26

endchoice


config LVGL_HOR_RES_MAX
	default 144

config LVGL_VER_RES_MAX
	default 168

config LS0XX
	default y

config LVGL_BITS_PER_PIXEL
	default 1

choice LVGL_COLOR_DEPTH
	default LVGL_COLOR_DEPTH_1

endchoice

config LVGL_DPI
	default 30

config LVGL_VDB_SIZE
	default 16


endif # ZMK_DISPLAY

endif
```

## Kconfig.shield
```kconfig
# Copyright (c) 2020 The ZMK Contributors
# SPDX-License-Identifier: MIT

config SHIELD_ACTIASLUNA
	def_bool $(shields_list_contains,actiasluna)
```
